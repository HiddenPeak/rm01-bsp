#include "led_animation_export.h"
#include "led_animation_demo.h"
#include "esp_log.h"
#include "bsp_storage.h"
#include "cJSON.h"
#include <stdio.h>
#include <string.h>

static const char *TAG = "LED_ANIM_EXPORT";

// 动画点数据结构
typedef struct {
    int x;
    int y;
    uint8_t r;
    uint8_t g;
    uint8_t b;
} animation_point_t;

// 示例动画数据（从led_animation_demo.c提取）
static const animation_point_t demo_points[] = {
    // 第8行
    {11, 8, 151, 189, 246},
    {22, 8, 220, 156, 208},
    {23, 8, 223, 157, 205},
    {24, 8, 232, 160, 199},
    
    // 第9行
    {9, 9, 146, 202, 247},
    {10, 9, 149, 192, 246},
    {11, 9, 153, 184, 246},
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    {25, 9, 240, 162, 195},
    
    // 第10行
    {8, 10, 145, 210, 247},
    {9, 10, 147, 203, 248},
    {10, 10, 148, 198, 247},
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    {23, 10, 226, 158, 202},
    
    // 第11行
    {8, 11, 145, 209, 247},
    {9, 11, 146, 203, 247},
    {10, 11, 148, 194, 246},
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    {22, 11, 220, 157, 208},
    
    // 第12行
    {8, 12, 145, 209, 247},
    {9, 12, 146, 202, 247},
    {10, 12, 149, 194, 246},
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    {23, 12, 226, 158, 203},
    
    // 第13行
    {8, 13, 146, 211, 247},
    {9, 13, 146, 204, 247},
    {10, 13, 149, 195, 247},
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    {24, 13, 235, 161, 198},
    
    // 第14行
    {8, 14, 145, 209, 247},
    {9, 14, 147, 203, 247},
    {10, 14, 149, 194, 246},
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    {25, 14, 241, 163, 195},
    
    // 第15行
    {8, 15, 145, 209, 247},
    {9, 15, 147, 203, 247},
    {10, 15, 149, 194, 246},
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    {25, 15, 241, 163, 195},
    
    // 第16行
    {8, 16, 145, 209, 247},
    {9, 16, 147, 203, 247},
    {10, 16, 149, 194, 246},
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    {25, 16, 241, 163, 195},
    
    // 第17行
    {8, 17, 145, 209, 247},
    {9, 17, 147, 203, 247},
    {10, 17, 149, 194, 246},
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    {25, 17, 241, 163, 195},
    
    // 第18行
    {9, 18, 146, 202, 247},
    {10, 18, 149, 194, 245},
    {15, 18, 178, 147, 242},
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    {25, 18, 241, 163, 195},
    
    // 第19行
    {10, 19, 150, 193, 247},
    {13, 19, 165, 162, 245},
    {14, 19, 172, 154, 243},
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    {25, 19, 241, 163, 195},
    
    // 第20行
    {11, 20, 153, 184, 246},
    {12, 20, 159, 172, 245},
    {13, 20, 165, 162, 245},
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    {25, 20, 241, 163, 195},
    
    // 第21行
    {10, 21, 149, 194, 246},
    {11, 21, 153, 183, 246},
    {12, 21, 158, 172, 245},
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    {25, 21, 241, 163, 195},
    
    // 第22行
    {8, 22, 145, 209, 247},
    {9, 22, 146, 202, 247},
    {10, 22, 149, 194, 246},
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    {24, 22, 234, 161, 197},
    
    // 第23行
    {9, 23, 147, 202, 247},
    {10, 23, 149, 193, 245},
    {11, 23, 153, 183, 245},
    {21, 23, 212, 153, 215},
    {22, 23, 218, 156, 209},
    {23, 23, 227, 159, 203},
};

// 导出示例动画为JSON文件
esp_err_t export_animation_to_json(const char *filename) {
    ESP_LOGI(TAG, "导出示例动画到JSON文件: %s", filename);
    
    // 检查SD卡是否挂载
    if (!bsp_storage_sdcard_is_mounted()) {
        ESP_LOGE(TAG, "SD卡未挂载，无法导出动画");
        return ESP_ERR_INVALID_STATE;
    }
    
    // 创建JSON对象
    cJSON *root = cJSON_CreateObject();
    if (!root) {
        ESP_LOGE(TAG, "无法创建JSON根对象");
        return ESP_ERR_NO_MEM;
    }
    
    // 创建动画数组
    cJSON *animations = cJSON_CreateArray();
    if (!animations) {
        ESP_LOGE(TAG, "无法创建动画数组");
        cJSON_Delete(root);
        return ESP_ERR_NO_MEM;
    }
    
    // 创建示例动画对象
    cJSON *animation = cJSON_CreateObject();
    if (!animation) {
        ESP_LOGE(TAG, "无法创建动画对象");
        cJSON_Delete(root);
        return ESP_ERR_NO_MEM;
    }
    
    // 设置动画名称
    cJSON_AddStringToObject(animation, "name", "示例动画");
    
    // 创建点数组
    cJSON *points = cJSON_CreateArray();
    if (!points) {
        ESP_LOGE(TAG, "无法创建点数组");
        cJSON_Delete(root);
        return ESP_ERR_NO_MEM;
    }
    
    // 添加所有点
    int num_points = sizeof(demo_points) / sizeof(demo_points[0]);
    ESP_LOGI(TAG, "添加 %d 个动画点", num_points);
    
    for (int i = 0; i < num_points; i++) {
        cJSON *point = cJSON_CreateObject();
        if (!point) {
            ESP_LOGE(TAG, "无法创建点对象 %d", i);
            continue;
        }
        
        cJSON_AddStringToObject(point, "type", "point");
        cJSON_AddNumberToObject(point, "x", demo_points[i].x);
        cJSON_AddNumberToObject(point, "y", demo_points[i].y);
        cJSON_AddNumberToObject(point, "r", demo_points[i].r);
        cJSON_AddNumberToObject(point, "g", demo_points[i].g);
        cJSON_AddNumberToObject(point, "b", demo_points[i].b);
        
        cJSON_AddItemToArray(points, point);
    }
    
    // 添加点数组到动画
    cJSON_AddItemToObject(animation, "points", points);
    
    // 添加动画到动画数组
    cJSON_AddItemToArray(animations, animation);
    
    // 添加动画数组到根对象
    cJSON_AddItemToObject(root, "animations", animations);
    
    // 生成JSON字符串
    char *json_string = cJSON_Print(root);
    if (!json_string) {
        ESP_LOGE(TAG, "无法生成JSON字符串");
        cJSON_Delete(root);
        return ESP_ERR_NO_MEM;
    }
    
    // 写入文件
    FILE *file = fopen(filename, "w");
    if (!file) {
        ESP_LOGE(TAG, "无法创建文件: %s", filename);
        free(json_string);
        cJSON_Delete(root);
        return ESP_ERR_INVALID_ARG;
    }
    
    size_t written = fwrite(json_string, 1, strlen(json_string), file);
    fclose(file);
    
    if (written != strlen(json_string)) {
        ESP_LOGE(TAG, "写入文件失败，期望 %d 字节，实际写入 %d 字节", 
                strlen(json_string), written);
        free(json_string);
        cJSON_Delete(root);
        return ESP_ERR_INVALID_SIZE;
    }
    
    ESP_LOGI(TAG, "成功导出 %d 个动画点到文件: %s", num_points, filename);
    ESP_LOGI(TAG, "JSON文件大小: %d 字节", strlen(json_string));
    
    // 清理内存
    free(json_string);
    cJSON_Delete(root);
    
    return ESP_OK;
}
